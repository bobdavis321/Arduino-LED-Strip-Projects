// Version for sending data to 12 Parallel WS2812 strings
// by: BOB Davis  
// Removed Assembler and simplified the code

// PORTD is Digital Pins 0-7 on the Uno change for other boards. 
#define PIXEL_PORT  PORTD  // Port the pixels are connected to
#define PIXEL_DDR   DDRD   // Port the pixels are connected to
// PORT B is D8-D13
#define PIXEL_PORTB  PORTB  // Port the pixels are connected to
#define PIXEL_DDRB   DDRB   // Port the pixels are connected to
int textb=128;  // brightness of text
int maxled=90;
String text1="ARDUINO LED STRIP PROJECTS    ";
// Set default color for letters 
int red=textb; int green=textb; int blue=textb;

// Send the next set of 8 WS2812B encoded bits to the 8 pins.
// The delay timing is for an Arduino UNO.
void sendBitX8( byte bits, byte bith ) {
  PORTD= 0xFF;  // turn on
  PORTB= 0xFF;  // turn on
  PORTD= 0xFF;  // delay
  PORTD= 0xFF;  // delay
  PORTD= 0xFF;  // delay (add more for faster processors)
  PORTD= bits;  // send data
  PORTB= bith;  // send data
  PORTD= bits;  // delay
  PORTD= bits;  // delay
  PORTD= bits;  // delay
  PORTD= 0x00;  // Turn off;
  PORTB= 0x00;  // Turn off;
}

void sendPixelRow( word row ) {
  // separate out upper and lower bytes from word
  byte rowh = row >> 8;
  // Send the bit 8 times down every row, each pixel is 8 bits/color
  int mask = 0x01;  // shifting mask to determine bit status
    for (int bit=8; bit>0; bit--){       
      if (green & (mask<<bit))sendBitX8( row, rowh ); else sendBitX8( 0x0000, 0x0000 ); }
    for (int bit=8; bit>0; bit--){       
      if (red & (mask<<bit))sendBitX8( row, rowh ); else sendBitX8( 0x0000, 0x0000 ); }
    for (int bit=8; bit>0; bit--){       
      if (blue & (mask<<bit))sendBitX8( row, rowh ); else sendBitX8( 0x0000, 0x0000 ); }
 }
    

// Hand typed 8x12 Font rotated to vertical values
// Based on Michael J. Karas of Carousel Design Solutions
word font[][8] = {
0x00,0x00,0x00,0x00,0x00,0x00,0x00,0x00, // ascii 32 
0x000,0x000,0x780,0xFEC,0xFEC,0x780,0x000,0x000, // !
0x000,0xE00,0xF00,0x000,0x000,0xF00,0xE00,0x000, // "
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0xC1C,0xC3C,0x864,0x8C4,0x984,0xB04,0xE0C,0x000, // Z
};
  

void setup() {
  PIXEL_DDR = 0xFF;    // Set all row pins to output
  PIXEL_DDRB = 0xFF;     // Set pins to output 
}
void loop() {
// 256 SHADE COLOR TEST
  cli();                      // No time for interruptions!
  for (int l=0; l<(maxled/4); l++){ // max number lines to send
    red=l+2; green=0; blue=0;    
    sendPixelRow(0xFFF);       // Light red
  }
  for (int l=0; l<(maxled/4); l++){ // max number lines to send
    red=0; green=l+2; blue=0;    
    sendPixelRow(0xFFF);       // Light green
  }
  for (int l=0; l<(maxled/4); l++){ // max number lines to send
    red=0; green=0; blue=l+2;    
    sendPixelRow(0xFFF);       // Light blue
  }
  for (int l=0; l<(maxled/4); l++){ // max number lines to send
    red=l+2; green=l+2; blue=l+2;    
    sendPixelRow(0xFFF);       // Light white
  }
  sei();
  delay(3000);                  // Wait to display results
  
  red=textb; green=0; blue=0;
  cli();                        // No time for interruptions!
  for (int l=0; l<30; l++){     // 30 is number of characters to send
    switch (l){                 // case is faster than if's
      case 0: red=textb; green=0; blue=0; break; // red
      case 1: red=0; green=textb; blue=0; break;  // green
      case 2: red=0; green=0; blue=textb; break;  // blue
      case 3: red=textb; green=textb; blue=0; break; //yellow
      case 4: red=0; green=textb; blue=textb; break; // cyan
      case 5: red=textb; green=0; blue=textb; break; // purple
      case 6: red=textb; green=0; blue=0; break; // red
      case 7: red=0; green=textb; blue=0; break;  // green
      case 8: red=0; green=0; blue=textb; break;  // blue
      case 9: red=textb; green=textb; blue=0; break; //yellow
      case 10: red=0; green=textb; blue=textb; break; // cyan
      case 11: red=textb; green=0; blue=textb; break; // purple
    }
    // Using a loop is too slow with the character lookups.
    sendPixelRow(font[text1[l]-32][0]); // -32 is to get to correct ascii
    sendPixelRow(font[text1[l]-32][1]); // -32 is to get to correct ascii
    sendPixelRow(font[text1[l]-32][2]); // -32 is to get to correct ascii
    sendPixelRow(font[text1[l]-32][3]); // -32 is to get to correct ascii
    sendPixelRow(font[text1[l]-32][4]); // -32 is to get to correct ascii
    sendPixelRow(font[text1[l]-32][5]); // -32 is to get to correct ascii
    sendPixelRow(font[text1[l]-32][6]); // -32 is to get to correct ascii
    sendPixelRow(font[text1[l]-32][7]); // -32 is to get to correct ascii
  }
  sei();
  delay(8000);                  // Wait to display results
  return;  
}

