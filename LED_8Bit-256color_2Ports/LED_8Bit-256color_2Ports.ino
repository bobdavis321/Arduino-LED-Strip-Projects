// Version for sending data to 8 Parallel WS2812 strings
// by: BOB Davis  
// Configured for using port D and port B for up to 14 bits!

// PORTD is Digital Pins 0-7 on the Uno change for other boards. 
#define PIXEL_PORT  PORTD  // Port the pixels are connected to
#define PIXEL_DDR   DDRD   // Port the pixels are connected to
#define PIXEL_PORTB  PORTB  // Port the pixels are connected to
#define PIXEL_DDRB   DDRB   // Port the pixels are connected to
int textb=128;  // brightness of text
int maxled=180;

// Send the next set of 8 WS2812B encoded bits to the 8 pins.
// The delay timing is for an Arduino UNO.
void sendBitX8( byte bitl, byte bith ) {
  PORTD= 0xFF;  // turn on
  PORTB= 0xFF;  // turn on
  PORTD= 0xFF;  // delay
  PORTD= 0xFF;  // delay
  PORTD= 0xFF;  // delay (add more for faster processors)
  PORTD= bith;  // send data
  PORTB= bitl;  // send data
  PORTD= bith;  // delay
  PORTD= bith;  // delay
  PORTD= bith;  // delay
  PORTD= 0x00;  // Turn off;
  PORTB= 0x00;  // Turn off;
}

// Set default color for letters 
int red=1; int green=textb; int blue=1;  

void sendPixelRow( byte row ) {
  // Send the bit 8 times down every row, each pixel is 8 bits/color
 int mask = 0x01;  // shifting mask to determine bit status
 int rowh=row;   // Pord D gets higher bits
 int rowl=row;   // Port B gets lower bits
    for (int bit=8; bit>0; bit--){       
      if (green & (mask<<bit))sendBitX8( rowl, rowh ); else sendBitX8( 0x00, 0x00 ); }
    for (int bit=8; bit>0; bit--){       
      if (red & (mask<<bit))sendBitX8( rowl, rowh ); else sendBitX8( 0x00, 0x00 ); }
    for (int bit=8; bit>0; bit--){       
      if (blue & (mask<<bit))sendBitX8( rowl, rowh ); else sendBitX8( 0x00, 0x00 ); }
 }
    
char text[]="ARDUINO ADXABLE LED PROJECTS    ";

// This font from http://sunge.awardspace.com/glcd-sd/node4.html
byte font[][6] = {
0x00,0x00,0x00,0x00,0x00,0x00, // ascii 32 
0x00,0x00,0xfa,0x00,0x00,0x00, // !
0x00,0xe0,0x00,0xe0,0x00,0x00, // "
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0x86,0x8a,0x92,0xa2,0xc2,0x00, // Z
};

void setup() {
//  Serial.begin(9600);   // opens serial port uses D0 and D1!
  PIXEL_DDR = 0xFF;     // Set pins to output  
  PIXEL_DDRB = 0xFF;     // Set pins to output 
}
void loop() {
  red=0; green=textb; blue=0;  
  
  cli();                        // No time for interruptions!
  for (int l=0; l<30; l++){     // 30 is number of characters to send
    // Using a loop is too slow with the character lookups.
    sendPixelRow(font[text[l]-32][0]); // -32 is to get to correct ascii
    sendPixelRow(font[text[l]-32][1]); // -32 is to get to correct ascii
    sendPixelRow(font[text[l]-32][2]); // -32 is to get to correct ascii
    sendPixelRow(font[text[l]-32][3]); // -32 is to get to correct ascii
    sendPixelRow(font[text[l]-32][4]); // -32 is to get to correct ascii
    sendPixelRow(font[text[l]-32][5]); // -32 is to get to correct ascii
  }
  sei();
  delay(4000);                  // Wait to display results

  cli();                        // No time for interruptions!
  for (int l=0; l<maxled; l++){     // 30 is number of characters to clear
    sendPixelRow(0x00);       // clear the screen
  }
  sei();

// FIREWORKS
  cli();                        // No time for interruptions!
  red=textb;  green=textb;  blue=textb;
  for (int cycle=0; cycle<100; cycle++){
    int rabit=random(7);
    byte ls=0x01;
    byte sbit=ls << rabit;      // Set up random bit
    int rano=random(maxled);        // Set Random location
    for (int l=0; l<maxled; l++){   // 180 is number of bytes to send
      if (l==rano) sendPixelRow(sbit); else sendPixelRow(0x00);  
    } 
    delay(20); 
  }
  sei();
  return;  
}

