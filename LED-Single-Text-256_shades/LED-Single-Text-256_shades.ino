// Program for sending data to one WS2812 string
// ZIGZAG text displayed
// By Robert Davis II
// Uses Digital Pin 6 change for other pins. 
int LEDpin=6;
int MaxLed=256;  // how many LED's
char PixelRow;
int textc=128;  // brightness of text

// Set default color for letters 
int red=1; int green=1; int blue=1;

// The delay timing is for an Arduino UNO.
// Sorry digitalWrite is too slow to use.
void sendBit( uint8_t bits ) {
  PORTD= 0xF0;  // turn on
  PORTD= 0xF0;  // delay
  PORTD= 0xF0;  // delay
  PORTD= 0xF0;  // delay
  PORTD= 0xF0;  // delay (Add more for faster processors)
  PORTD= bits;  // send data
  PORTD= bits;  // delay
  PORTD= bits;  // delay
  PORTD= bits;  // delay
  PORTD= bits;  // delay
  PORTD= 0x00;  // Turn off;
}

void sendColor( uint8_t row ) {
 // Send the bit 8 times down the row, each pixel is 8 bits each for R,G,B
 int mask = 0x01;  // shifting mask to determine bit status
    for (int bit=8; bit>0; bit--){       
      if (green & (mask<<bit))sendBit( row ); else sendBit( 0x00 ); }
    for (int bit=8; bit>0; bit--){       
      if (red & (mask<<bit))sendBit( row ); else sendBit( 0x00 ); }
    for (int bit=8; bit>0; bit--){       
      if (blue & (mask<<bit))sendBit( row ); else sendBit( 0x00 ); }
 }

char text1[]="ARDUINO POWERED WS2812 LED SIGN                    ";

// This font from http://sunge.awardspace.com/glcd-sd/node4.html
byte font[][6] = {
0x00,0x00,0x00,0x00,0x00,0x00, // ascii 32 
0x00,0x00,0xfa,0x00,0x00,0x00, // !
0x00,0xe0,0x00,0xe0,0x00,0x00, // "
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0x10,0x38,0x54,0x10,0x10,0x00, // 
};
 
void setup() {
  pinMode (LEDpin, OUTPUT);
  }
  
void loop() {
  // RED COLOR TEST
  red=1; green=0; blue=0;
  cli();                        // No time for interruptions!
  for (int l=0; l<MaxLed/4; l++){     //  number of LED's
    red=l;
    sendColor( 0xF0);       // Light All red
    }
  // GREEN COLOR TEST
  red=0; green=1; blue=0;
  for (int l=0; l<MaxLed/4; l++){     //  number of LED's
    green=l;
    sendColor( 0xF0);       // Light All green
    }
  // BLUE COLOR TEST
  red=0; green=0; blue=1;
  for (int l=0; l<MaxLed/4; l++){     //  number of LED's
    blue=l;
    sendColor( 0xF0);       // Light All blue
    }
  // WHITE COLOR TEST
  for (int l=0; l<MaxLed/4; l++){     //  number of LED's
    red=l; green=l; blue=l;
    sendColor( 0xF0);       // Light All white
    }
  sei();
  delay(2000);

  //TEXT with ZIGZAG layout tested bit order reverses for each column.
  cli();                        // No time for interruptions!
  for (int l=0; l<30; l++){     // 30 is number of characters to send
      switch (l){                 // case is faster than if's
      case 0: red=textc; green=0; blue=0; break; 
      case 1: red=0; green=textc; blue=0; break; 
      case 2: red=0; green=0; blue=textc; break; 
      case 3: red=textc; green=0; blue=0; break; 
      case 4: red=0; green=textc; blue=0; break; 
      case 5: red=0; green=0; blue=textc; break; 
    }
    for (int r=0; r<6; r++) {
      PixelRow=(font[text1[l]-32][r]); // -32 is to get to correct ascii
      if (r & 0x01){     // invert odd rows
      // Using a loop and shifting is too slow with the character lookups.
      if (PixelRow & 0x01 ) sendColor (0xF0); else sendColor (0x00);
      if (PixelRow & 0x02 ) sendColor (0xF0); else sendColor (0x00);
      if (PixelRow & 0x04 ) sendColor (0xF0); else sendColor (0x00);
      if (PixelRow & 0x08 ) sendColor (0xF0); else sendColor (0x00);
      if (PixelRow & 0x10 ) sendColor (0xF0); else sendColor (0x00);
      if (PixelRow & 0x20 ) sendColor (0xF0); else sendColor (0x00);
      if (PixelRow & 0x40 ) sendColor (0xF0); else sendColor (0x00);
      if (PixelRow & 0x80 ) sendColor (0xF0); else sendColor (0x00);
      }
      else{
      if (PixelRow & 0x80 ) sendColor (0xF0); else sendColor (0x00);
      if (PixelRow & 0x40 ) sendColor (0xF0); else sendColor (0x00);
      if (PixelRow & 0x20 ) sendColor (0xF0); else sendColor (0x00);
      if (PixelRow & 0x10 ) sendColor (0xF0); else sendColor (0x00);
      if (PixelRow & 0x08 ) sendColor (0xF0); else sendColor (0x00);
      if (PixelRow & 0x04 ) sendColor (0xF0); else sendColor (0x00);
      if (PixelRow & 0x02 ) sendColor (0xF0); else sendColor (0x00);
      if (PixelRow & 0x01 ) sendColor (0xF0); else sendColor (0x00);
      }
    }
  }
  sei();
  delay(4000);                  // Wait to display results

  // FIREWORKS
  red=textc; green=textc; blue=textc;  
  cli();                        // No time for interruptions!
  for (int cycle=0; cycle<500; cycle++){
    int rano=random(MaxLed);        // Set Random location
    for (int l=0; l<MaxLed; l++){   // number of bytes to send
      if (l==rano) sendColor( 0xF0); else sendColor( 0x00);  
    } 
    delay(20); 
  }
  sei();
  return;  
}

