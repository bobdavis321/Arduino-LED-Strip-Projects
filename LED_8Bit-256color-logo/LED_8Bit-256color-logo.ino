// Version for sending data to 8 Parallel WS2812 strings
// by: BOB Davis  
// Any BMP Viewer

// PORTD is Digital Pins 0-7 on the Uno change for other boards. 
#define PIXEL_PORT  PORTD  // Port the pixels are connected to
#define PIXEL_DDR   DDRD   // Port the pixels are connected to
int textb=128;    // brightness of text
int maxled=180;   // maximum number of LED's in sign
byte sarray[180*3]; // three times max led
int imgwidth=90;  // image number of pixels wide
byte mbyte;
#include <avr/pgmspace.h>
//byte mred; byte mgreen; byte mblue;
// Set default color for letters 
int red=10; int green=10; int blue=10; 

// Send the next set of 8 WS2812B encoded bits to the 8 pins.
// The delay timing is for an Arduino UNO.
void sendBitX8( byte bits ) {
  PORTD= 0xFF;  // turn on
  PORTD= 0xFF;  // delay
  PORTD= 0xFF;  // delay
  PORTD= 0xFF;  // delay
  PORTD= 0xFF;  // delay (add more for faster processors)
  PORTD= bits;  // send data
  PORTD= bits;  // delay
  PORTD= bits;  // delay
  PORTD= bits;  // delay
  PORTD= bits;  // delay
  PORTD= 0x00;  // Turn off;
}

int mask = 0x01;  // will shift mask to determine bit status
void sendPixelRow( byte mred, byte mgreen, byte mblue ) {
  // Send the bit 8 times down every row, each pixel is 8 bits/color
    for (int mbit=8; mbit>0; mbit--){ 
      if (green & mask<<mbit)sendBitX8( mgreen ); else sendBitX8( 0x00 );} 
    for (int mbit=8; mbit>0; mbit--){       
      if (red & mask<<mbit)sendBitX8( mred ); else sendBitX8( 0x00 ); }
    for (int mbit=8; mbit>0; mbit--){       
      if (blue & mask<<mbit)sendBitX8( mblue ); else sendBitX8( 0x00 ); }
 }
    
// Generated by   : ImageConverter 565 Online
// Generated from : Logo-90.jpg
// bits per pixel: 24


static const byte Logo[] PROGMEM = {
    0x18, 0x17, 0x1c, 0x06, 0x0d, 0x00, 0x29, 0x38, 0x0f, 0x5f, 0x74, 0x39, 0x5f, 0x7d, 0x37,
    0x7a, 0x9c, 0x4f, 0x77, 0x9d, 0x48, 0x79, 0x9d, 0x43, 0x78, 0x96, 0x3e, 0x68, 0x80, 0x32,
    0x51, 0x65, 0x2a, 0x0e, 0x1c, 0x00, 0x09, 0x0e, 0x07, 0x1a, 0x19, 0x1e, 0x19, 0x17, 0x1a,
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    0x1d, 0x18, 0x1c, 0x1a, 0x1a, 0x1c, 0x19, 0x1b, 0x1a, 0x1a, 0x1a, 0x1a,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 0x1d
};
int mmax=maxled*3;  //maxled for all three colors
int tlevel = 120;  // trigger level
int mwide=imgwidth*3;
int c=0; // controls scrolling 
int dir =1; // controls direction of scrolling

void setup() {
  PIXEL_DDR = 0xff;    // Set all row pins to output
}

void loop() {
  // Clear array
  for (int k=0; k < mmax; k++)  {
    sarray[k] = 0x00;
  }  
  // Offset array
  if (dir==1) {c=c+1;}
  if (dir==0) {c=c-1;}
  if (c==0) {dir=1;}
  if (c==20) {dir=0;} 
  int coff = c*270; // offset * one row

   // Create top of array 
   for (int k=0; k < imgwidth*3; k++)  {
    mbyte = pgm_read_byte_near(Logo+k+coff);
    if (mbyte>tlevel) {sarray[k]=sarray[k]+0x80;}
    mbyte = pgm_read_byte_near(Logo+k+imgwidth*3+coff);
    if (mbyte>tlevel) {sarray[k]=sarray[k]+0x40;}
    mbyte = pgm_read_byte_near(Logo+k+imgwidth*6+coff);
    if (mbyte>tlevel) {sarray[k]=sarray[k]+0x20;}
    mbyte = pgm_read_byte_near(Logo+k+imgwidth*9+coff);
    if (mbyte>tlevel) {sarray[k]=sarray[k]+0x10;}
    mbyte = pgm_read_byte_near(Logo+k+imgwidth*12+coff);
    if (mbyte>tlevel) {sarray[k]=sarray[k]+0x08;}
    mbyte = pgm_read_byte_near(Logo+k+imgwidth*15+coff);
    if (mbyte>tlevel) {sarray[k]=sarray[k]+0x04;}
    mbyte = pgm_read_byte_near(Logo+k+imgwidth*18+coff);
    if (mbyte>tlevel) {sarray[k]=sarray[k]+0x02;}
    mbyte = pgm_read_byte_near(Logo+k+imgwidth*21+coff);
    if (mbyte>tlevel) {sarray[k]=sarray[k]+0x01;}
    // create bottom half
    mbyte = pgm_read_byte_near(Logo+k+imgwidth*24+coff);
    if (mbyte>tlevel) {sarray[k+mwide]=sarray[k+mwide]+0x80;}
    mbyte = pgm_read_byte_near(Logo+k+imgwidth*27+coff);
    if (mbyte>tlevel) {sarray[k+mwide]=sarray[k+mwide]+0x40;}
    mbyte = pgm_read_byte_near(Logo+k+imgwidth*30+coff);
    if (mbyte>tlevel) {sarray[k+mwide]=sarray[k+mwide]+0x20;}
    mbyte = pgm_read_byte_near(Logo+k+imgwidth*33+coff);
    if (mbyte>tlevel) {sarray[k+mwide]=sarray[k+mwide]+0x10;}
    mbyte = pgm_read_byte_near(Logo+k+imgwidth*36+coff);
    if (mbyte>tlevel) {sarray[k+mwide]=sarray[k+mwide]+0x08;}
    mbyte = pgm_read_byte_near(Logo+k+imgwidth*39+coff);
    if (mbyte>tlevel) {sarray[k+mwide]=sarray[k+mwide]+0x04;}
    mbyte = pgm_read_byte_near(Logo+k+imgwidth*42+coff);
    if (mbyte>tlevel) {sarray[k+mwide]=sarray[k+mwide]+0x02;}
    mbyte = pgm_read_byte_near(Logo+k+imgwidth*45+coff);
    if (mbyte>tlevel) {sarray[k+mwide]=sarray[k+mwide]+0x01;}
    
  }  
 // }

  red=textb; green=textb; blue=textb;
  cli();                        // No time for interruptions!
  for (int l=0; l<mmax; l=l+3){     //  send array
    sendPixelRow(sarray[l], sarray[l+1], sarray[l+2] );  
  }
  sei();
  delay(200);                  // Wait to display results
  return; 
 
   
}

