// Version for sending data to 8 Parallel WS2812 strings
// by: BOB Davis  
// Scrolling Text Version

// PORTD is Digital Pins 0-7 on the Uno change for other boards. 
#define PIXEL_PORT  PORTD  // Port the pixels are connected to
#define PIXEL_DDR   DDRD   // Port the pixels are connected to
int textb=128;    // brightness of text
int maxled=180;   // Number of LED's
byte texts[360]; // Characters times Columns (30x6=180)*2
char text[]="    ARDUINO LED STRIP PROJECTS           ";
// Set default color for letters 
int red=1; int green=textb; int blue=1;  

// Send the next set of 8 WS2812B encoded bits to the 8 pins.
// The delay timing is for an Arduino UNO.
void sendBitX8( uint8_t bits ) {
  PORTD= 0xFF;  // turn on
  PORTD= 0xFF;  // delay
  PORTD= 0xFF;  // delay
  PORTD= 0xFF;  // delay
  PORTD= 0xFF;  // delay (add more for faster processors)
  PORTD= bits;  // send data
  PORTD= bits;  // delay
  PORTD= bits;  // delay
  PORTD= bits;  // delay
  PORTD= bits;  // delay
  PORTD= 0x00;  // Turn off;
}

void sendPixelRow( uint8_t row ) {
  // Send the bit 8 times down every row, each pixel is 8 bits/color
  int mask = 0x01;  // shifting mask to determine bit status
    for (int bit=8; bit>0; bit--){       
      if (green & (mask<<bit))sendBitX8( row ); else sendBitX8( 0x00 ); }
    for (int bit=8; bit>0; bit--){       
      if (red & (mask<<bit))sendBitX8( row ); else sendBitX8( 0x00 ); }
    for (int bit=8; bit>0; bit--){       
      if (blue & (mask<<bit))sendBitX8( row ); else sendBitX8( 0x00 ); }
 }
    
// Font from http://sunge.awardspace.com/glcd-sd/node4.html
byte font[][6] = {
0x00,0x00,0x00,0x00,0x00,0x00, // ascii 32 
0x00,0x00,0xfa,0x00,0x00,0x00, // !
0x00,0xe0,0x00,0xe0,0x00,0x00, // "
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0x86,0x8a,0x92,0xa2,0xc2,0x00, // Z
};

void setup() {
  PIXEL_DDR = 0xff;    // Set all row pins to output
}
void loop() {
  red=1; green=textb; blue=1;  
  // Load Array
  for (int l=0; l<30; l++){     // 30 is number of characters to send
    for (int r=0; r<6; r++){     // 6 rows per character
      texts[(l*6)+r]=(font[text[l]-32][r]); // -32 is to get to correct ascii
    }
  }
  for (int l=0; l<30; l++){     // 30 is number of characters to send
    for (int r=0; r<6; r++){     // 6 rows per character
      texts[(l*6+maxled)+r]=0x00;     //  Blanks otherwise see memory contents
    }
  }

  // Display Array
  cli();                          // No time for interruptions!
  for (int s=0; s<maxled; s++){   // s in number to skip
    for (int l=0; l<maxled; l++){    // number of LEDs to send
      sendPixelRow(texts[l+s]);   // send array to display
    }
    delay(5000);
  }
  sei();

  cli();                          // No time for interruptions!
  for (int l=0; l<maxled; l++){     // number of LEDs to clear
    sendPixelRow(0x00);          // clear the screen
  }
  sei();

  // FIREWORKS
  red=textb;  green=textb;  blue=textb;
  cli();                        // No time for interruptions!
  for (int cycle=0; cycle<100; cycle++){
    int rabit=random(7);
    byte ls=0x01;
    byte sbit=ls << rabit;      // Set up random bit
    int rano=random(maxled);        // Set Random location
    for (int l=0; l<maxled; l++){   // 180 is number of bytes to send
      if (l==rano) sendPixelRow(sbit); else sendPixelRow(0x00);  
    } 
    delay(20); 
  }
  sei();
  return;  
}

